## example_code/openai-realtime-demo/sdkconfig.defaults
```kconfig
# ESP Event Loop on Linux
CONFIG_ESP_EVENT_POST_FROM_ISR=n
CONFIG_ESP_EVENT_POST_FROM_IRAM_ISR=n

# Disable TLS verification
# Production needs to include specific cert chain you care about
CONFIG_ESP_TLS_INSECURE=y
CONFIG_ESP_TLS_SKIP_SERVER_CERT_VERIFY=y

CONFIG_OPENAI_BOARD_SPARK_BOT=y

# Enable DTLS-SRTP
CONFIG_MBEDTLS_SSL_PROTO_DTLS=y

# libpeer requires large stack allocations
CONFIG_ESP_MAIN_TASK_STACK_SIZE=4096

# Defaults to partitions.csv
CONFIG_PARTITION_TABLE_CUSTOM=y

# Set highest CPU Freq
CONFIG_ESP_DEFAULT_CPU_FREQ_MHZ_240=y

CONFIG_SPIRAM=y
CONFIG_SPIRAM_MODE_OCT=y

# Disable Watchdog
# CONFIG_ESP_INT_WDT is not set
# CONFIG_ESP_TASK_WDT_EN is not set

# Enable Compiler Optimization
CONFIG_COMPILER_OPTIMIZATION_PERF=y
CONFIG_COMPILER_OPTIMIZATION_ASSERTIONS_DISABLE=y

CONFIG_LWIP_TCPIP_RECVMBOX_SIZE=64
CONFIG_LWIP_MAX_UDP_PCBS=1024
CONFIG_LWIP_UDP_RECVMBOX_SIZE=64
CONFIG_I2C_BUS_BACKWARD_CONFIG=y
CONFIG_LV_COLOR_16_SWAP=y
```

## example_code/openai-realtime-demo/src/Kconfig.projbuild
```kconfig
menu "OpenAI Board Configuration"

    choice OPENAI_BOARD_TYPE
    prompt "openai board type"
    default OPENAI_BOARD_ESP32_S3

        config OPENAI_BOARD_ESP32_S3
            bool "default demo board ESP32-S3"

        config OPENAI_BOARD_SPARK_BOT
            bool "Spark Bot"

    endchoice

endmenu
```
